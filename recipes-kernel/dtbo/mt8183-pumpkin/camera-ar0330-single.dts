// SPDX-License-Identifier: GPL-2.0
/*
 * Copyright (c) 2020 Laurent Pinchart <laurent.pinchart@ideasonboard.com>
 */

#include "camera-ar0330-dual.dtsi"

/ {
	fragment@6 {
		target = <&i2c4>;
		__overlay__ {
			sensor@10 {
				status = "disabled";
			};
		};
	};
};
