// SPDX-License-Identifier: GPL-2.0
/*
 * Copyright (c) 2020 Laurent Pinchart <laurent.pinchart@ideasonboard.com>
 */

#include "camera-ap1302-ar0330-single-ar0144-single.dtsi"

/ {
	fragment@6 {
		target = <&i2c4>;
		__overlay__ {
			camera@3c {
				status = "disabled";
			};
		};
	};
};
