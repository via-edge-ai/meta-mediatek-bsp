## conf/layer.conf
```bitbake
# We have a conf and classes directory, add to BBPATH
BBPATH .= ":${LAYERDIR}"

# We have recipes-* directories, add to BBFILES
BBFILES += "${LAYERDIR}/recipes-*/*/*.bb ${LAYERDIR}/recipes-*/*/*.bbappend"
BBFILES_DYNAMIC += " \
	multimedia-layer:${LAYERDIR}/dynamic-layers/multimedia-layer/*/*/*.bbappend \
"

BBFILE_COLLECTIONS += "mediatek-bsp"
BBFILE_PATTERN_mediatek-bsp = "^${LAYERDIR}/"
BBFILE_PRIORITY_mediatek-bsp = "7"

# This should only be incremented on significant changes that will
# cause compatibility issues with other layers
LAYERVERSION_mediatek-bsp = "1"

LAYERDEPENDS_mediatek-bsp = "core openembedded-layer meta-python meta-arm"

LAYERSERIES_COMPAT_mediatek-bsp = "hardknott"

NON_MULTILIB_RECIPES_remove = " u-boot "

AIOT_PROTOCOL ?= "git://git@"
AIOT_URI = "${AIOT_PROTOCOL}gitlab.com/mediatek/aiot"
AIOT_BSP_URI = "${AIOT_URI}/bsp"
AIOT_NDA_URI = "${AIOT_URI}/nda"
AIOT_RITY_URI = "${AIOT_URI}/rity"
AIOT_BAYLIBRE_URI = "${AIOT_URI}/team-baylibre"

RICH_IOT_URI = "${AIOT_PROTOCOL}gitlab.com/baylibre/rich-iot"
```

## conf/machine/i300-pumpkin-common.inc
```bitbake
require mt7668.inc

MACHINEOVERRIDES =. "i300-pumpkin:"

# Kernel
DTB_LOADADDRESS = "0x44000000"
KERNEL_DEVICETREE_OVERLAYS += "vesper.dtbo"
KERNEL_DEVICETREE_OVERLAYS_AUTOLOAD += " \
	${@bb.utils.contains("MACHINE_FEATURES", "vesper-hat", "vesper.dtbo", "", d)} \
"

# U-Boot
UBOOT_ENTRYPOINT = "0x40080000"
UBOOT_LOADADDRESS = "0x40080000"
UBOOT_DTB_LOADADDRESS = "0x44000000"
UBOOT_DTBO_LOADADDRESS = "0x44c00000"
UBOOT_MACHINE = "pumpkin_defconfig"

# TF-A priv
TFA_BOARD_NAME = "pumpkin"

# LK
LK_PROJECT = "pumpkin8516-emmc"

MACHINE_FEATURES_append = " alsa bluetooth usbgadget usbhost wifi"

DISTRO_FEATURES_append = " dtbo "
```

## conf/machine/include/i300-pumpkin-common.inc
```bitbake
require mt7668.inc

MACHINEOVERRIDES =. "i300-pumpkin:"

# Kernel
DTB_LOADADDRESS = "0x44000000"
KERNEL_DEVICETREE_OVERLAYS_AUTOLOAD += " \
	${@bb.utils.contains("MACHINE_FEATURES", "vesper-hat", "vesper.dtbo", "", d)} \
	${@bb.utils.contains("I300_PUMPKIN_AUDIO_CONF", "i2s", "audio-i2s.dtbo", "", d)} \
"

# U-Boot
UBOOT_ENTRYPOINT = "0x40200000"
UBOOT_LOADADDRESS = "0x40200000"
UBOOT_DTB_LOADADDRESS = "0x44000000"
UBOOT_DTBO_LOADADDRESS = "0x44c00000"
UBOOT_MACHINE = "mt8516_pumpkin_defconfig"

# TF-A priv
TFA_BOARD_NAME = "mt8516-pumpkin"

# libdram
LIBDRAM_BOARD_NAME = "mt8516-pumpkin"

# LK
LK_PROJECT = "pumpkin8516-emmc"

MACHINE_FEATURES:append = " alsa bluetooth usbgadget usbhost wifi"

DISTRO_FEATURES:append = " dtbo "
```

## conf/machine/include/mediatek-common.inc
```bitbake
MACHINEOVERRIDES =. "mtk:"

# Kernel
KERNEL_CLASSES = "kernel-fitimage-mtk"
KERNEL_IMAGETYPE = "fitImage"
KERNEL_COMPRESSION = "gzip"

# U-Boot
UBOOT_SUFFIX = "bin"
UBOOT_ENV_SUFFIX = "script"
UBOOT_ENV = "boot"
UBOOT_ENTRYPOINT       = "0x40200000"
UBOOT_LOADADDRESS      = "0x40200000"
UBOOT_DTB_LOADADDRESS  = "0x44000000"
UBOOT_DTBO_LOADADDRESS = "0x44c00000"
UBOOT_SIGN_ENABLE = "1"

# OP-TEE OS
PREFERRED_PROVIDER_virtual/optee-os ?= "optee-os"
PREFERRED_VERSION_optee-client ?= "3.16"
PREFERRED_VERSION_optee-examples ?= "3.16"
PREFERRED_VERSION_optee-os:mtk ?= "3.16"
PREFERRED_VERSION_optee-os-tadevkit ?= "3.16"
PREFERRED_VERSION_optee-test ?= "3.16"
OPTEE_TZDRAM_START ?= "0x43200000"
OPTEE_TZDRAM_SIZE  ?= "0x00a00000"

IMAGE_BOOT_FILES = " \
	${KERNEL_IMAGETYPE} \
"

IMAGE_FSTYPES ?= "wic.img aiotflash.tar"
IMAGE_ROOTFS_ALIGNMENT = "4"
IMAGE_CLASSES += "image_type_img image_type_aiotflash"

SERIAL_CONSOLES = "921600;ttyS0"

WKS_FILE ?= "mediatek.wks"
WIC_CREATE_EXTRA_ARGS += "-i direct-with-blksz"
WIC_SECTOR_SIZE ?= "512"
WIC_BLOCK_SIZE ?= "1024"
WICVARS:append = " WIC_SECTOR_SIZE WIC_BLOCK_SIZE"
do_image_wic[depends] += " \
	trusted-firmware-a:do_deploy \
	virtual/kernel:do_deploy \
"

PREFERRED_PROVIDER_virtual/dtb = "dtbo"
PREFERRED_PROVIDER_virtual/kernel ?= "linux-mtk"
PREFERRED_PROVIDER_virtual/bootloader ?= "u-boot"
PREFERRED_PROVIDER_virtual/lk ?= "${@bb.utils.contains("DISTRO_FEATURES", "nda-mtk", "lk", "lk-prebuilt", d)}"

PREFERRED_VERSION_linux-mtk ??= "5.10%"

EXTRA_IMAGEDEPENDS = " \
	virtual/lk \
	trusted-firmware-a \
	rity-tools \
"

MACHINE_EXTRA_RRECOMMENDS += " \
	kernel-modules \
	packagegroup-mtk \
"

# Set this only for factory image
# An image built with this option should not be shipped to customers
OPTEE_RPMB_WRITE_KEY ??= "0"
# Set this only to use the RPMB test key instead of generating an unique one
OPTEE_RPMB_TEST_KEY ??= "0"

MACHINE_EXTRA_RRECOMMENDS:append = " ${@bb.utils.contains("DISTRO_FEATURES", "optee-otp", " optee-otp", "", d)}"

# Set this to sign BL2 and support DAA
BL2_SIGN_ENABLE ??= "0"
DA_SIGN_ENABLE ??= "0"

# Allowed license for mtk device - overrideable if necessary
MTK_EXTRA_LICENSE_FLAGS_ACCEPTED ?= "commercial"

# Packages requiring extra licenses
LICENSE_FLAGS_ACCEPTED:append:pn-libmali = " ${MTK_EXTRA_LICENSE_FLAGS_ACCEPTED}"
```

## conf/machine/include/mt7663.inc
```bitbake
MTK_WIRELESS_RELEASE ?= "alps-release-r0.mp5-aiot"
MTK_WIRELESS_CHIP = "MT7663"
MACHINEOVERRIDES =. "mt7663:"

MACHINE_EXTRA_RRECOMMENDS:append = " \
	${@bb.utils.contains("DISTRO_FEATURES", "nda-mtk wifi", "kernel-module-mt7663-tk-wifi", "kernel-module-mt7663s", d)} \
	${@bb.utils.contains("DISTRO_FEATURES", "bluetooth", "linux-firmware-mt7663", "", d)} \
	${@bb.utils.contains("DISTRO_FEATURES", "nda-mtk wifi", "", "mt7663-service", d)} \
	${@bb.utils.contains("DISTRO_FEATURES", "nda-mtk", "wifitest", "", d)} \
"
```

## conf/machine/include/mt7668.inc
```bitbake
MACHINEOVERRIDES =. "mt7668:"

MACHINE_ESSENTIAL_EXTRA_RDEPENDS:append = " \
	${@bb.utils.contains("DISTRO_FEATURES", "nda-mtk wifi", "kernel-module-mt7668-tk-wifi", "", d)} \
	${@bb.utils.contains("DISTRO_FEATURES", "nda-mtk bluetooth", "linux-firmware-mt7668", "", d)} \
"

MACHINE_EXTRA_RRECOMMENDS:append = " \
	${@bb.utils.contains("DISTRO_FEATURES", "nda-mtk", "wifitest", "", d)} \
"
```

## conf/machine/include/mt8167.inc
```bitbake
require conf/machine/include/tune-cortexa35.inc
require conf/machine/include/soc-family.inc
require mediatek-common.inc

SOC_FAMILY = "mt8167"

# Trusted Firmware-A
TFA_PLATFORM = "mt8516"

# OP-TEE
OPTEE_TARGET = "mediatek-mt8516"
OPTEE_DRAM_SIZE = "0x80000000"

# LK
LK_PROJECT = "pumpkin8516-emmc"

DISTRO_FEATURES_append = " optee "
DISTRO_FEATURES_remove = " x11 "

IMGTEC_VERSION ??= "1.13@5776728"
IMGTEC_FW ??= "rgx.fw.22.40.54.30"
IMGTEC_SH ??= "rgx.sh.22.40.54.30"

MACHINE_EXTRA_RRECOMMENDS_append = " \
	imgtec-pvr \
"

PREFERRED_PROVIDER_virtual/egl ?= "imgtec-pvr"
PREFERRED_PROVIDER_virtual/libegl ?= "imgtec-pvr"
PREFERRED_PROVIDER_virtual/libgbm ?= "imgtec-pvr"
PREFERRED_PROVIDER_virtual/libgl ?= "imgtec-pvr"
PREFERRED_PROVIDER_virtual/libgles2 ?= "imgtec-pvr"
PREFERRED_PROVIDER_virtual/mesa ?= "imgtec-pvr"
PREFERRED_PROVIDER_virtual/opencl ?= "imgtec-pvr"

MACHINEOVERRIDES =. "mt8362:mt8362a:i300:i300a:"
```

## conf/machine/include/mt8183.inc
```bitbake
require conf/machine/include/tune-cortexa73-cortexa53.inc
require conf/machine/include/soc-family.inc
require mediatek-common.inc

SOC_FAMILY = "mt8183"

# Trusted Firmware-A
TFA_PLATFORM = "mt8183"

# OP-TEE
OPTEE_TARGET = "mediatek-mt8183"
OPTEE_DRAM_SIZE = "0x80000000"

# LK
LK_PROJECT = "mt8183-evb"

DISTRO_FEATURES:append = " optee "
DISTRO_FEATURES:remove = " x11 "

# Mali
KERNEL_MODULE_AUTOLOAD += "dma-buf-test-exporter"
MALI_SOC = "mt8183"
MALI_VERSION ??= "r32p0"

MACHINE_EXTRA_RRECOMMENDS:append = " \
	libmali \
	linux-firmware-mt8183-scp \
"

PREFERRED_PROVIDER_virtual/egl ?= "libmali"
PREFERRED_PROVIDER_virtual/libegl ?= "libmali"
PREFERRED_PROVIDER_virtual/libgbm ?= "libmali"
PREFERRED_PROVIDER_virtual/libgl ?= "libmali"
PREFERRED_PROVIDER_virtual/libgles1 ?= "libmali"
PREFERRED_PROVIDER_virtual/libgles2 ?= "libmali"
PREFERRED_PROVIDER_virtual/mesa ?= "libmali"
PREFERRED_PROVIDER_virtual/opencl ?= "libmali"

MACHINEOVERRIDES =. "mt8385:i500:"
```
