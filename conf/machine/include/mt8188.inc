## conf/machine/include/mt8188.inc
```bitbake
require conf/machine/include/arm/arch-armv8a.inc
require conf/machine/include/soc-family.inc
require mediatek-common.inc

SOC_FAMILY = "mt8188"

# Trusted Firmware-A
TFA_PLATFORM = "mt8188"

# OP-TEE
OPTEE_TARGET = "mediatek-mt8188"
OPTEE_DRAM_SIZE = "0x80000000"

# LK
LK_PROJECT = "mt8390-evk"

MACHINE_FEATURES:append = " optee"
MACHINE_FEATURES:append = " ${@bb.utils.contains("DISTRO_FEATURES", "nda-mtk", "optee-efuse", "", d)}"

DISTRO_FEATURES:remove = " x11 "

# Mali
MALI_SOC = "mt8188"
MALI_VERSION ??= "48"

MACHINE_EXTRA_RRECOMMENDS:append = " \
	mali-gpu-driver \
"

PREFERRED_PROVIDER_virtual/egl ?= "libmali"
PREFERRED_PROVIDER_virtual/libegl ?= "libmali"
PREFERRED_PROVIDER_virtual/libgbm ?= "libmali"
PREFERRED_PROVIDER_virtual/libgl ?= "libmali"
PREFERRED_PROVIDER_virtual/libgles1 ?= "libmali"
PREFERRED_PROVIDER_virtual/libgles2 ?= "libmali"
PREFERRED_PROVIDER_virtual/libgles3 ?= "libmali"
PREFERRED_PROVIDER_virtual/mesa ?= "libmali"
PREFERRED_PROVIDER_virtual/opencl ?= "libmali"

MACHINEOVERRIDES =. "mt8390:genio-700:"
```

## conf/machine/include/mt8195.inc
```bitbake
require conf/machine/include/arm/arch-armv8a.inc
require conf/machine/include/soc-family.inc
require mediatek-common.inc

SOC_FAMILY = "mt8195"

# Trusted Firmware-A
TFA_PLATFORM = "mt8195"

# OP-TEE
OPTEE_TARGET = "mediatek-mt8195"
OPTEE_DRAM_SIZE = "0x80000000"

# LK
LK_PROJECT = "mt8395-demo"

DISTRO_FEATURES:append = " optee "
DISTRO_FEATURES:remove = " x11 "

# Mali
KERNEL_MODULE_AUTOLOAD += "dma-buf-test-exporter"
MALI_SOC = "mt8195"
MALI_VERSION ??= "r31p0"

MACHINE_EXTRA_RRECOMMENDS:append = " \
	libmali \
"

PREFERRED_PROVIDER_virtual/egl ?= "libmali"
PREFERRED_PROVIDER_virtual/libegl ?= "libmali"
PREFERRED_PROVIDER_virtual/libgbm ?= "libmali"
PREFERRED_PROVIDER_virtual/libgl ?= "libmali"
PREFERRED_PROVIDER_virtual/libgles1 ?= "libmali"
PREFERRED_PROVIDER_virtual/libgles2 ?= "libmali"
PREFERRED_PROVIDER_virtual/mesa ?= "libmali"
PREFERRED_PROVIDER_virtual/opencl ?= "libmali"

MACHINEOVERRIDES =. "mt8395:i1200:"
```

## conf/machine/include/mt8365.inc
```bitbake
require conf/machine/include/arm/armv8a/tune-cortexa53.inc
require conf/machine/include/soc-family.inc
require mediatek-common.inc

SOC_FAMILY = "mt8365"

# Trusted Firmware-A
TFA_PLATFORM = "mt8365"

# OP-TEE
OPTEE_TARGET = "mediatek-mt8175"
OPTEE_DRAM_SIZE = "0x80000000"

# LK
LK_PROJECT = "mt8365-pumpkin"

MACHINE_FEATURES:append = " optee"
DISTRO_FEATURES:remove = " x11 "

# Mali
KERNEL_MODULE_AUTOLOAD += "dma-buf-test-exporter"
MALI_SOC = "mt8365"
MALI_VERSION ??= "r32p0"

MACHINE_EXTRA_RRECOMMENDS:append = " \
	libmali \
"

PREFERRED_PROVIDER_virtual/egl ?= "libmali"
PREFERRED_PROVIDER_virtual/libegl ?= "libmali"
PREFERRED_PROVIDER_virtual/libgbm ?= "libmali"
PREFERRED_PROVIDER_virtual/libgl ?= "libmali"
PREFERRED_PROVIDER_virtual/libgles1 ?= "libmali"
PREFERRED_PROVIDER_virtual/libgles2 ?= "libmali"
PREFERRED_PROVIDER_virtual/mesa ?= "libmali"
PREFERRED_PROVIDER_virtual/opencl ?= "libmali"

PREFERRED_RPROVIDER_virtual/mdpd ??= "${@bb.utils.contains("DISTRO_FEATURES", "nda-mtk", "mtk-mdpd", "mdp-prebuilt", d)}"

MACHINEOVERRIDES =. "i350:"
```

## conf/machine/include/mt8516.inc
```bitbake
require conf/machine/include/arm/armv8a/tune-cortexa35.inc
require conf/machine/include/soc-family.inc
require mediatek-common.inc

SOC_FAMILY = "mt8516"

# Trusted Firmware-A
TFA_PLATFORM = "mt8516"
TFA_USE_PREBUILT_BL2 = "yes"

# OP-TEE
OPTEE_TARGET = "mediatek-mt8516"
OPTEE_DRAM_SIZE = "0x40000000"

USE_VT = "0"

DISTRO_FEATURES:append = " optee "

MACHINEOVERRIDES =. "mt8362:mt8362b:i300:i300b:"
```

## conf/machine/mediatek-common.inc
```bitbake
# Kernel
KERNEL_IMAGETYPE = "fitImage"
KERNEL_COMPRESSION = "gzip"

# U-Boot
UBOOT_SUFFIX = "bin"
UBOOT_ENV_SUFFIX = "scr"
UBOOT_ENV = "boot"

IMAGE_BOOT_FILES = " \
	${KERNEL_IMAGETYPE} \
	${UBOOT_ENV}.${UBOOT_ENV_SUFFIX} \
"

IMAGE_FSTYPES ?= "ext4 wic"
IMAGE_ROOTFS_ALIGNMENT = "4"

SERIAL_CONSOLES = "921600;ttyS0"

WKS_FILE ?= "mediatek.wks"
do_image_wic[depends] += " \
	virtual/trusted-firmware-a:do_deploy \
	virtual/kernel:do_deploy \
"

PREFERRED_PROVIDER_virtual/kernel ??= "linux-mtk"
PREFERRED_PROVIDER_virtual/bootloader ??= "u-boot"
PREFERRED_PROVIDER_virtual/trusted-firmware-a ??= "trusted-firmware-a"

EXTRA_IMAGEDEPENDS = " \
	lk \
	virtual/trusted-firmware-a \
	mtk-flash-tools \
"

MACHINE_EXTRA_RRECOMMENDS += " \
	kernel-modules \
	packagegroup-mtk \
	u-boot-scr \
"
```

## conf/machine/mt7668.inc
```bitbake
MACHINEOVERRIDES =. "mt7668:"

MACHINE_ESSENTIAL_EXTRA_RDEPENDS_append = " \
	${@bb.utils.contains("DISTRO_FEATURES", "wifi", "kernel-module-mt7668-wifi", "", d)} \
	${@bb.utils.contains("DISTRO_FEATURES", "bluetooth", "linux-firmware-mt7668", "", d)} \
"

MACHINE_EXTRA_RRECOMMENDS_append = " \
	wifitest \
"
```

## conf/machine/mt8167-coral.conf
```bitbake
require include/mt8167.inc

# Kernel
KERNEL_DEVICETREE = "mediatek/mt8167-coral.dtb"

# U-Boot
UBOOT_MACHINE = "mt8516_pumpkin_defconfig"

# TF-A priv
TFA_BOARD_NAME = "mt8516-pumpkin"

# libdram
LIBDRAM_BOARD_NAME = "mt8516-pumpkin"

# LK
LK_PROJECT = "pumpkin8516-emmc"

MACHINE_FEATURES:append = " alsa bluetooth usbgadget usbhost wifi"

MACHINEOVERRIDES =. "mt8167-coral:mt8362a-coral:i300a-coral:"
```

## conf/machine/mt8167-pumpkin.conf
```bitbake
require include/mt8167.inc
require include/i300-pumpkin-common.inc

# Kernel
KERNEL_DEVICETREE = "mediatek/mt8167-pumpkin.dtb"

MACHINEOVERRIDES =. "mt8167-pumpkin:mt8362a-pumpkin:i300a-pumpkin:"
```

## conf/machine/mt8167-sb30.conf
```bitbake
require include/mt8167.inc
require include/mt7668.inc

# Kernel
KERNEL_DEVICETREE = "mediatek/mt8167-sb30.dtb"

# U-Boot
UBOOT_MACHINE = "mt8516_pumpkin_defconfig"

# TF-A priv
TFA_BOARD_NAME = "mt8516-pumpkin"

# libdram
LIBDRAM_BOARD_NAME = "mt8516-pumpkin"

# LK
LK_PROJECT = "pumpkin8516-emmc"

MACHINE_FEATURES:append = " alsa bluetooth usbgadget usbhost wifi"

MACHINEOVERRIDES =. "mt8167-sb30:mt8362a-sb30:i300a-sb30:"
```

## conf/machine/mt8167.inc
```bitbake
require conf/machine/include/tune-cortexa35.inc
require conf/machine/include/soc-family.inc
require mediatek-common.inc

SOC_FAMILY = "mt8167"

# Trusted Firmware-A
TFA_PLAT = "mt8516"

# OP-TEE
OPTEE_TARGET = "mediatek-mt8516"

# LK
LK_PROJECT = "pumpkin8516-emmc"

DISTRO_FEATURES_append = " optee "

IMGTEC_VERSION ??= "1.13@5776728"
IMGTEC_FW ??= "rgx.fw.22.40.54.30"
IMGTEC_SH ??= "rgx.sh.22.40.54.30"

MACHINE_EXTRA_RRECOMMENDS_append = " \
	imgtec-pvr \
"

PREFERRED_PROVIDER_virtual/egl ?= "imgtec-pvr"
PREFERRED_PROVIDER_virtual/libegl ?= "imgtec-pvr"
PREFERRED_PROVIDER_virtual/libgbm ?= "imgtec-pvr"
PREFERRED_PROVIDER_virtual/libgl ?= "imgtec-pvr"
PREFERRED_PROVIDER_virtual/libgles2 ?= "imgtec-pvr"
PREFERRED_PROVIDER_virtual/mesa ?= "imgtec-pvr"

PREFERRED_VERSION_weston = "9.0%"

MACHINEOVERRIDES =. "mt8362:mt8362a:i300:i300a:"
```

## conf/machine/mt8175-evb.conf
```bitbake
require mt8175.inc
require mt7668.inc

# Kernel
KERNEL_DEVICETREE = "mediatek/mt8175-evb.dtb"

# U-Boot
UBOOT_MACHINE = "mt8175_evb_defconfig"

MACHINE_FEATURES_append = " alsa bluetooth usbgadget usbhost wifi"

MACHINEOVERRIDES =. "mt8168-evb:mt8365-evb:i350-evb:"
```

## conf/machine/mt8175.inc
```bitbake
require conf/machine/include/tune-cortexa53.inc
require conf/machine/include/soc-family.inc
require mediatek-common.inc

SOC_FAMILY = "mt8175"

# Trusted Firmware-A
TFA_PLATFORM = "mt8175"

# OP-TEE
OPTEE_TARGET = "mediatek-mt8175"
OPTEE_DRAM_SIZE = "0x80000000"

# LK
LK_PROJECT = "mt8175-evb"

DISTRO_FEATURES_append = " optee "

MACHINEOVERRIDES =. "mt8168:mt8365:i500:"
```

## conf/machine/mt8183-evb.conf
```bitbake
require include/mt8183.inc
require include/mt7668.inc

# Kernel
KERNEL_DEVICETREE = "mediatek/mt8183-evb.dtb"

# libdram
LIBDRAM_BOARD_NAME = "mt8183-evb"

# U-Boot
UBOOT_MACHINE = "mt8183_pumpkin_defconfig"

MACHINE_FEATURES:append = " alsa bluetooth usbgadget usbhost wifi"

MACHINEOVERRIDES =. "mt8183-evb:mt8385-evb:i500-evb:genio-500-evb:"
```

## conf/machine/mt8183-pumpkin.conf
```bitbake
require include/mt8183.inc
require include/mt7668.inc

# Kernel
KERNEL_DEVICETREE = "mediatek/mt8183-pumpkin.dtb"

# U-Boot
UBOOT_MACHINE = "mt8183_pumpkin_defconfig"

# libdram
LIBDRAM_BOARD_NAME = "mt8183-pumpkin"

# onsemi-firmware
ONSEMI_BOARD_NAME = "OLogic_Pumpkin_i500"

MACHINE_FEATURES:append = " alsa bluetooth usbgadget usbhost wifi"

MACHINE_EXTRA_RRECOMMENDS:append = " \
	onsemi-firmware-ap1302-ar0330 \
	onsemi-firmware-ap1302-ar0144 \
	onsemi-firmware-ap1302-ar0144-dual \
	onsemi-firmware-ap1302-ar0430 \
	onsemi-firmware-ap1302-ar1335 \
"

MACHINEOVERRIDES =. "mt8183-pumpkin:mt8385-pumpkin:i500-pumpkin:"
```

## conf/machine/mt8183.inc
```bitbake
require conf/machine/include/tune-cortexa73-cortexa53.inc
require conf/machine/include/soc-family.inc
require mediatek-common.inc

SOC_FAMILY = "mt8183"

# Trusted Firmware-A
TFA_PLAT = "mt8183"

# OP-TEE
OPTEE_TARGET = "mediatek-mt8183"

# LK
LK_PROJECT = "mt8183-evb"

DISTRO_FEATURES_append = " optee "
DISTRO_FEATURES_remove = " x11 vulkan "

# Mali
MALI_GEN = "bifrost"
MALI_VERSION ??= "r20p0"

MACHINE_EXTRA_RRECOMMENDS_append = " \
	libmali \
"

PREFERRED_PROVIDER_virtual/egl ?= "libmali"
PREFERRED_PROVIDER_virtual/libegl ?= "libmali"
PREFERRED_PROVIDER_virtual/libgbm ?= "libmali"
PREFERRED_PROVIDER_virtual/libgl ?= "libmali"
PREFERRED_PROVIDER_virtual/libgles1 ?= "libmali"
PREFERRED_PROVIDER_virtual/libgles2 ?= "libmali"
PREFERRED_PROVIDER_virtual/mesa ?= "libmali"

PREFERRED_VERSION_weston = "4.0%"

MACHINEOVERRIDES =. "mt8385:i500:"
```

## conf/machine/mt8365-evb.conf
```bitbake
require mt8365.inc

# Kernel
KERNEL_DEVICETREE = "mediatek/mt8365-evb.dtb"

# U-Boot
UBOOT_ENTRYPOINT       = "0x40080000"
UBOOT_LOADADDRESS      = "0x40080000"
UBOOT_DTB_LOADADDRESS  = "0x44000000"
UBOOT_DTBO_LOADADDRESS = "0x44c00000"
UBOOT_MACHINE = "mt8365_evb_defconfig"

MACHINE_FEATURES_append = " alsa bluetooth usbgadget usbhost wifi"

MACHINE_ESSENTIAL_EXTRA_RDEPENDS = " \
	packagegroup-mtk-wireless \
"

MACHINEOVERRIDES =. "mt8168-evb:mt8365-evb:i350-evb:"
```

## conf/machine/mt8365-evk.conf
```bitbake
require include/mt8365.inc
require include/mt7663.inc

# Kernel
KERNEL_DEVICETREE = "mediatek/mt8365-evk.dtb"

# U-Boot
UBOOT_MACHINE = "mt8365_pumpkin_defconfig"

# libdram
LIBDRAM_BOARD_NAME = "mt8365-sb35"

# OP-TEE
OPTEE_DRAM_SIZE = "0xc0000000"

DISTRO_FEATURES:append = " dtbo "
MACHINE_FEATURES:append = " alsa bluetooth usbgadget usbhost wifi"

MACHINEOVERRIDES =. "mt8365-evk:i350-evk:"

# onsemi-firmware
ONSEMI_BOARD_NAME = "MediaTek_AIoT_i350_EVK"

MACHINE_EXTRA_RRECOMMENDS:append = " \
        onsemi-firmware-ap1302-ar0430 \
"
```

## conf/machine/mt8365-pumpkin.conf
```bitbake
require include/mt8365.inc
require include/mt7663.inc

# Kernel
KERNEL_DEVICETREE = "mediatek/mt8365-pumpkin.dtb"

# U-Boot
UBOOT_MACHINE = "mt8365_pumpkin_defconfig"

# libdram
LIBDRAM_BOARD_NAME = "mt8365-pumpkin"

MACHINE_FEATURES:append = " alsa bluetooth usbgadget usbhost wifi"

MACHINEOVERRIDES =. "mt8365-pumpkin:i350-pumpkin:"

# onsemi-firmware
ONSEMI_BOARD_NAME = "OLogic_Pumpkin_i500"
MACHINE_EXTRA_RRECOMMENDS:append = " \
         onsemi-firmware-ap1302-ar0330 \
         onsemi-firmware-ap1302-ar0144 \
         onsemi-firmware-ap1302-ar0144-dual \
"
```

## conf/machine/mt8365-sb35.conf
```bitbake
require include/mt8365.inc
require include/mt7663.inc

# Kernel
KERNEL_DEVICETREE = "mediatek/mt8365-sb35.dtb"

# U-Boot
UBOOT_MACHINE = "mt8365_pumpkin_defconfig"

# libdram
LIBDRAM_BOARD_NAME = "mt8365-sb35"

# LK
LK_BOARD_NAME = "${LIBDRAM_BOARD_NAME}"

MACHINE_FEATURES:append = " alsa usbgadget usbhost wifi"

MACHINEOVERRIDES =. "mt8365-sb35:i350-sb35:genio-350-sb35:"
```

## conf/machine/mt8365.inc
```bitbake
require conf/machine/include/tune-cortexa53.inc
require conf/machine/include/soc-family.inc
require mediatek-common.inc

SOC_FAMILY = "mt8365"

# Trusted Firmware-A
TFA_PLAT = "mt8365"

# OP-TEE
OPTEE_TARGET = "mediatek-mt8365"

# LK
LK_PROJECT = "mt8365-evb"

DISTRO_FEATURES_append = " optee "

MACHINEOVERRIDES =. "mt8168:mt8175:i500:"
```

## conf/machine/mt8370-evk.conf
```bitbake
require include/mt8370.inc
require include/mt7921.inc

# Kernel
KERNEL_DEVICETREE = "mediatek/genio-510-evk.dtb"


# U-Boot
UBOOT_MACHINE = "genio_510_evk_defconfig"

# libdram
LIBDRAM_BOARD_NAME = "genio-700-evk"

# OP-TEE
OPTEE_DRAM_SIZE = "0x200000000"

# LK
LK_BOARD_NAME = "${LIBDRAM_BOARD_NAME}"

MACHINE_FEATURES:append = " alsa bluetooth pci usbgadget usbhost wifi tsn"

MACHINEOVERRIDES =. "mt8370-evk:genio-510-evk:"

# onsemi-firmware
ONSEMI_BOARD_NAME = "MediaTek_Genio"
MACHINE_EXTRA_RRECOMMENDS:append = " \
        onsemi-firmware-ap1302-ar0430 \
"
```

## conf/machine/mt8390-evk.conf
```bitbake
require include/mt8188.inc
require include/mt7921.inc

# Kernel
KERNEL_DEVICETREE = "mediatek/genio-700-evk.dtb"


# U-Boot
UBOOT_MACHINE = "genio_700_evk_defconfig"

# libdram
LIBDRAM_BOARD_NAME = "genio-700-evk"


MACHINE_FEATURES:append = " alsa bluetooth pci usbgadget usbhost wifi tsn"

MACHINEOVERRIDES =. "mt8188-evk:mt8390-evk:"
```

## conf/machine/mt8395-demo.conf
```bitbake
require include/mt8195.inc
require include/mt7921.inc

# Kernel
KERNEL_DEVICETREE = "mediatek/mt8195-demo.dtb"

# U-Boot
UBOOT_MACHINE = "mt8195_demo_defconfig"

# libdram
LIBDRAM_BOARD_NAME = "mt8395-demo"

# OP-TEE
OPTEE_DRAM_SIZE = "0x200000000"

# LK
LK_BOARD_NAME = "${LIBDRAM_BOARD_NAME}"

MACHINE_FEATURES:append = " alsa bluetooth pci usbgadget usbhost wifi tsn"

MACHINEOVERRIDES =. "mt8195-demo:mt8395-demo:i1200-demo:genio-1200-demo:"
```

## conf/machine/mt8395-evk-ufs.conf
```bitbake
require include/mt8195.inc
require include/mt7921.inc

# Kernel
KERNEL_DEVICETREE = "mediatek/genio-1200-evk.dtb"

# U-Boot
UBOOT_MACHINE = "genio_1200_evk_ufs_defconfig"

# libdram
LIBDRAM_BOARD_NAME = "genio-1200-evk-ufs"

# OP-TEE
OPTEE_DRAM_SIZE = "0x200000000"

# LK
LK_PROJECT = "mt8395-evk-ufs"

# UFS storage
WIC_SECTOR_SIZE = "4096"
WIC_BLOCK_SIZE = "4096"
MACHINE_FEATURES:append = " ufs-boot "

MACHINE_FEATURES:append = " alsa bluetooth pci usbgadget usbhost wifi tsn"

MACHINEOVERRIDES =. "mt8395-evk:genio-1200-evk:mt8395-evk-ufs:genio-1200-evk-ufs:"
```

## conf/machine/mt8395-evk.conf
```bitbake
require include/mt8195.inc
require include/mt7921.inc

# Kernel
KERNEL_DEVICETREE = "mediatek/genio-1200-evk.dtb"

# U-Boot
UBOOT_MACHINE = "genio_1200_evk_defconfig"

# libdram
LIBDRAM_BOARD_NAME = "mt8395-demo"

# OP-TEE
OPTEE_DRAM_SIZE = "0x200000000"

MACHINE_FEATURES:append = " alsa bluetooth pci usbgadget usbhost wifi tsn"

MACHINEOVERRIDES =. "mt8395-evk:genio-1200-evk:"
```
